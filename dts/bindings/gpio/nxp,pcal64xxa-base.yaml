## dts/bindings/gpio/nxp,pcal64xxa-base.yaml
```yaml
# Copyright (c) 2021 Nordic Semiconductor ASA
# Copyright (c) 2023 SILA Embedded Solutions GmbH
# SPDX-License-Identifier: Apache-2.0

include: [i2c-device.yaml, gpio-controller.yaml]

properties:
  int-gpios:
    type: phandle-array
    description: |
      GPIO connected to the controller INT pin. This pin is active-low.

  reset-gpios:
    type: phandle-array
    description: |
      GPIO connected to the controller RESET pin. This pin is active-low.

  port0-open-drain-enable:
    type: boolean
    description: Enable open-drain mode for Port 0 (pins 0-7) ODEN0

  port1-open-drain-enable:
    type: boolean
    description: Enable open-drain mode for Port 1 (pins 8-15) ODEN1

  "#gpio-cells":
    const: 2

gpio-cells:
  - pin
  - flags
```
